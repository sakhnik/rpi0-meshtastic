## meta-my/conf/distro/mydistro.conf
```bitbake
require conf/distro/poky.conf

DISTRO = "mydistro"
DISTRO_NAME = "RPi Meshtasticd Distro"
DISTRO_VERSION = "1.0"

DISTRO_FEATURES:remove = " bluetooth"
DISTRO_FEATURES:append = " systemd usrmerge wifi"
DISTRO_FEATURES_BACKFILL_CONSIDERED += "sysvinit"

VIRTUAL-RUNTIME_init_manager = "systemd"
VIRTUAL-RUNTIME_initscripts = ""

PACKAGE_CLASSES = "package_ipk"

EXTRA_IMAGE_FEATURES ?= "ssh-server-dropbear"

hostname:forcevariable = "meshtastic"
```
